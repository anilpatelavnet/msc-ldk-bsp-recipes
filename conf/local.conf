## conf/local.conf
```bitbake
# Copyright (C) 2021 AVNET Embedded, MSC Technologies GmbH

MACHINE = "sm2s-am6254"

# default build to ipk. rpm create issue.
PACKAGE_CLASSES = "package_ipk"

# Qemu 0.12.x is giving too much problems recently (2010.05), so disable it for users
ENABLE_BINARY_LOCALE_GENERATION = "0"

DISTRO   = "arago"

# Set terminal types by default it expects gnome-terminal
# but we chose xterm
TERMCMD = "${XTERM_TERMCMD}"
TERMCMDRUN = "${XTERM_TERMCMDRUN}"

# Generate the mirror tarball for SCM repos
BB_GENERATE_MIRROR_TARBALLS = "1"

# Keep one set of images by default
RM_OLD_IMAGE = "1"

# Enable local PR service for binary feeds
PRSERV_HOST = "localhost:0"

BSPDIR := "${@os.path.abspath(os.path.dirname(d.getVar('FILE', True)) + '/../../../')}"

DISTRO_FEATURES_remove = "directfb x11"
DISTRO_FEATURES_append = " wayland pam"

# Use internal toolchain, the common Yocto way
TOOLCHAIN_TYPE = "internal"

# locale-base package is not supported when we use external-arm-toolchain
IMAGE_INSTALL_remove += "\
        locale-base-de-de \
"
```

## meta/conf/machine/sm2s-am6254-k3r5-hs-se.conf
```bitbake
# Copyright (C) 2022 AVNET Embedded

#@TYPE: Machine
#@NAME: AM62XX (R5F)
#@DESCRIPTION: Machine configuration for the TI AM62xx (R5F core)

#Derived from meta-ti/conf/machine/am62xx-evm-k3r5.conf

MACHINEOVERRIDES =. "am62xx-evm-k3r5-hs-se:"
require ../../meta-ti.git/conf/machine/include/k3r5.inc
SOC_FAMILY_append = ":k3r5-hs-se"


SYSFW_SOC = "am62x"
SYSFW_CONFIG = "evm"
SYSFW_SUFFIX = "hs"

UBOOT_MACHINE = "am62x_evm_r5_defconfig"

SYSFW_TIBOOT3_SYMLINK = ""

SPL_BINARY = ""
UBOOT_BINARY = "u-boot-spl.${UBOOT_SUFFIX}"
UBOOT_IMAGE = "u-boot-r5spl-hs-se-${MAINMACHINE}-${PV}-${PR}.${UBOOT_SUFFIX}"
UBOOT_SYMLINK = "u-boot-r5spl-hs-se.${UBOOT_SUFFIX}"
```

## meta/conf/machine/sm2s-am6254.conf
```bitbake
# Copyright (C) 2022 AVNET Embedded

#@TYPE: Machine
#@NAME: AM6254 based avnet custom board design
#@DESCRIPTION: Machine configuration for the Avnet based custom TI AM6254

#Derived from meta-ti/conf/machine/am62xx-evm.conf

require ../../meta-ti.git/conf/machine/include/am62xx.inc

# Add machine override to replicate am62xx-evm changes for our board as well
MACHINEOVERRIDES =. "am62xx-evm:"

MACHINE_FEATURES += "gpu"

KERNEL_DEVICETREE = " \
    ti/sm2s-am625x-rev1.dtb \
    ti/k3-am625-sk.dtb \
    ti/k3-am625-skeleton.dtb \
    ti/k3-am625-sk-lpmdemo.dtb \
    ti/k3-am625-sk-csi2-ov5640.dtbo \
    ti/k3-am625-sk-csi2-tevi-ov5640.dtbo \
    ti/k3-am625-sk-ecap-capture.dtbo \
    ti/k3-am625-sk-hdmi-audio.dtbo \
    ti/k3-am625-sk-mcan.dtbo \
    ti/k3-am625-sk-oldi-panel.dtbo \
"

UBOOT_MACHINE = "am62x_evm_a53_defconfig"

ROOTFS_POSTPROCESS_COMMAND_remove += " remove_boot; "

SPL_BINARY = "tispl.bin_HS"
UBOOT_BINARY = "u-boot.img_HS"
UBOOT_SYMLINK = "u-boot.img"
```
